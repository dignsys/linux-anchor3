## Documentation/devicetree/bindings/mtd/nxp3220_nand.txt
```
Nexell nxp3220 NAND Flash Controller

Required properties:
- compatible : "nexell,nxp3220-nand".
- reg : Offset and length of the register set for the controller device.
- interrupts : shall define the nand controller interrupt.
- clocks : shall reference nand controller clocks.
- clock-names : nand controller internal clock names. Shall contain :
    * "nand_apb" : nand APB clock
    * "nand_core" : nand controller clock
- nand-ecc-mode : must "hw_syndrome".
- nand-timing-mode : refer to the nand datasheet and select the appropriate
		     timing mode value corresponding to onfi mode (0 ~ 5).
		     Obtain the value of the onfi field corresponding to the
		     timing mode (nanosecond) and convert it to the appropriate
		     value for nexell nfc controller.
- wp-gpio : GPIO specifier for the write protect pin.

 <Onfi Timing Mode>

  mode	tCLS	tWP	tCLH	tCH	tALS	tWC	tWH	tRHW	tWHR
 -------------------------------------------------------------------------------
  0	50	50	20	20	50	100	30	200	120
  1	25	25	10	10	25	45	15	100	80
  2	15	17	10	10	15	35	15	100	80
  3	10	15	5	5	10	30	10	100	80
  4	10	12	5	5	10	25	10	100	80
  5	10	10	5	5	10	20	7	100	80

	#define ns2cycle_r(ns, clk)	\
		(int)(((ns) * (clk / 1000000) + 999) / 1000)

	cmd_setup = ns2cycle_r((tCLS - tWP) / nand_core_hz)
	cmd_width = ns2cycle_r(tWP, nand_core_hz);
	cmd_hold = ns2cycle_r(tCLH, nand_core_hz);
	rhw = ns2cycle_r(tRHW, nand_core_hz);

	data_setup = ns2cycle_r(tALS - tWP, nand_core_hz);
	data_width = ns2cycle_r(tWC, nand_core_hz);
	data_hold = ns2cycle_r((tWC - tWP), nand_core_hz);
	whr = ns2cycle_r(tWHR, nand_core_hz);

see Documentation/devicetree/bindings/mtd/nand.txt for generic bindings.


Examples:
nand: nand-controller@26180000 {
	compatible = "nexell,nxp3220-nand";
	reg = <0x26180000 0x1000>;
	clocks = <&cmu CLK_NANDC0_APB>,
		 <&cmu CLK_NANDC0_AXI>;
	clock-names = "nand_apb", "nand_core";
	interrupts = <GIC_SPI 66 IRQ_TYPE_NONE>;
	assigned-clocks = <&cmu CLK_SRC_NANDC0_AXI>,
			  <&cmu CLK_NANDC0_AXI>,
			  <&cmu CLK_NANDC0_APB>;
	assigned-clock-parents = <&pll_0 0>, <0>, <0>;
	assigned-clock-rates = <250000000>, <250000000>, <125000000>;
	wp-gpio = <&gpio_c 16 GPIO_ACTIVE_LOW>;
	pinctrl-names = "default";
	pinctrl-0 = <&nand_pins>;
	nand-bus-width = <8>;
	nand-on-flash-bbt;

	nand-ecc-mode = "hw_syndrome";
	nand-ecc-strength = <4>;
	nand-ecc-step-size = <512>;

	nand-timing-mode = <3>;
};
```

## Documentation/devicetree/bindings/phy/nexell-usb2-phy.txt
```
Nexell USB2 PHY
-----------------------

Required properties:
- compatible : should be one of the listed compatibles:
	 "nexell,nxp3220-usb2-phy"
- reg : a list of offset + length pairs
- #phy-cells : from the generic phy bindings, must be 1
- clocks and clock-names:
	- the "ahb" clock is required by the usb block modules, used as gate
	- the "apb" clock is required by the usb tieoff block, used as gate

Optional properties:
- otg,vbus-gpio: If present, specifies a gpio that needs to be activated for
	the bus to be powered.
- ehci,vbus-gpio: If present, specifies a gpio that needs to be activated for
	the bus to be powered.
- phy-supply: supply for USB phy

Example:

usb2phy: usb2phy@24030000 {
	compatible = "nexell,nxp3220-usb2-phy";
	reg = <0x24030000 0x200>;
	#phy-cells = <1>;
	clocks = <&cmu_usb CLK_USB_AHB>, <&cmu_usb CLK_USB_SYSREG_APB>;
	clock-names = "ahb", "apb";
};

&usb2phy {
        otg,vbus-gpio = <&gpio_c 12 GPIO_ACTIVE_HIGH>;
        ehci,vbus-gpio = <&gpio_b 23 GPIO_ACTIVE_HIGH>;
        status = "okay";
};
```

## Documentation/devicetree/bindings/pinctrl/nexell,nxp3220-pinctrl.txt
```
Binding for Nexell nxp3220 pin cotroller
========================================

Nexell's ARM bases SoC's integrates a GPIO and Pin mux/config hardware
controller. It controls the input/output settings on the available pads/pins
and also provides ability to multiplex and configure the output of various
on-chip controllers onto these pads.

Please refer to pinctrl-bindings.txt in this directory for details of the
common pinctrl bindings used by client devices, including the meaning of the
phrase "pin configuration node".


Required properties:
  - compatible: may be "nexell,nxp3220-pinctrl"
  - reg: should be register base and length as documented in the datasheet
  - interrupts: interrupt specifier for the controller over gpio and alive pins

Example:
pinctrl_0: pinctrl {
	compatible = "nexell,nxp3220-pinctrl";
	#address-cells = <1>;
	#size-cells = <1>;
	reg = <PHYS_BASE_GPIOA 0x1000
	       PHYS_BASE_GPIOB 0x1000
	       PHYS_BASE_GPIOC 0x1000
	       PHYS_BASE_GPIOD 0x1000
	       PHYS_BASE_GPIOE 0x1000
	       PHYS_BASE_ALIVE 0x800>;
	interrupts = <0 IRQ_GPIOA 0>,
		     <0 IRQ_GPIOB 0>,
		     <0 IRQ_GPIOC 0>,
		     <0 IRQ_GPIOD 0>,
		     <0 IRQ_GPIOE 0>,
		     <0 IRQ_ALIVE 0>;
};

  Note: Setting up the order must always match.


Nexell's pin configuration nodes act as a container for an arbitrary number of
subnodes. Each of these subnodes represents some desired configuration for a
pin, a group, or a list of pins or groups. This configuration can include the
mux function to select on those pin(s)/group(s), and various pin configuration
parameters.

  Child nodes must be set at least one of the following settings:
  - nexell,pins = Select pins for using this function.
  - nexell,pin-function = Select the function for use in a selected pin.
  - nexell,pin-pull = Pull up/down configuration.
  - nexell,pin-strength = Drive strength configuration.

  Child nodes must be set for the powerdown retention:
  - nexell,pin-pwr-domain = Select powerdown retention pin's power domain.
  - nexell,pin-pwr-drv = Select the powerdown retention direction.
  - nexell,pin-pwr-val = Set powerdown retention output value.
  - nexell,pin-pwr-pull = Set powerdown retention pull up/down configuration.

  Valid values for nexell,pins are:
     "gpioX-N"		: X in {A,B,C,D,E}, N in {0-31}
  Valid values for nexell,pin-function are:
     "NX_PIN_FUNC0", "NX_PIN_FUNC1", "NX_PIN_FUNC2", "NX_PIN_FUNC3"
                 This setting means that the value is different for each pin.
                 Please refer to datasheet.
  Valid values for nexell,pin-pull are:
     "NX_PIN_PULL_DOWN", "NX_PIN_PULL_UP", "NX_PIN_PULL_NONE"
  Valid values for nexell,pin-strength are:
     "NX_PIN_STR0", "NX_PIN_STR1", "NX_PIN_STR2", "NX_PIN_STR3"

  Valid values for nexell,pin-pwr-domain are:
     - for the nxp3220
     "NX_PIN_PWR_DOMAIN_PERI0" : power domain 'peri0'
     "NX_PIN_PWR_DOMAIN_SDMMC" : power domain 'sdmmc'
     "NX_PIN_PWR_DOMAIN_NAND" : power domain 'nand'
     "NX_PIN_PWR_DOMAIN_PERI1" : power domain 'peri1'
     "NX_PIN_PWR_DOMAIN_GMAC" : power domain 'gmac'
     "NX_PIN_PWR_DOMAIN_PERI2" : power domain 'peri2'
     "NX_PIN_PWR_DOMAIN_VIP" : power domain 'vip'
  Valid values for nexell,pin-pwr-drv are:
     "NX_PIN_PWR_NONE" : No powerdown retention
     "NX_PIN_PWR_INPUT": Set input powerdown retention
     "NX_PIN_PWR_OUTPUT" : Set output powerdown retention
     "NX_PIN_PWR_PREV" : Set output powerdown retention with previous state
  Valid values for nexell,pin-pwr-val are:
     "NX_PIN_PWR_RETEN_LOW" : Set output powerdown retention with low
     "NX_PIN_PWR_RETEN_HIGH" : Set output powerdown retention with high
  Valid values for nexell,pin-pwr-pull are:
     "NX_PIN_PWR_PULL_DOWN" : Set pull down powerdown retention
     "NX_PIN_PWR_PULL_UP": Set pull up powerdown retention
     "NX_PIN_PWR_PULL_NONE": Set pull off powerdown retention
     "NX_PIN_PWR_PULL_PREV": Keep previous pull state powerdown retention

Example:
  - pin settings
	gmac_txd: gmac-txd {
		nexell,pins = "gpioc-18", "gpioc-19", "gpioc-20", "gpioc-21";
		nexell,pin-function = <NX_PIN_FUNC1>;
		nexell,pin-pull = <NX_PIN_PULL_NONE>;
		nexell,pin-strength = <NX_PIN_STR3>;
	};

	gmac_rxd: gmac-rxd {
		nexell,pins = "gpioc-24", "gpioc-25", "gpioc-26", "gpioc-27";
		nexell,pin-function = <NX_PIN_FUNC1>;
		nexell,pin-pull = <NX_PIN_PULL_NONE>;
		nexell,pin-strength = <NX_PIN_STR3>;
	};

	gmac_txen: gmac-txen {
		nexell,pins = "gpioc-22";
		nexell,pin-function = <NX_PIN_FUNC1>;
		nexell,pin-pull = <NX_PIN_PULL_NONE>;
		nexell,pin-strength = <NX_PIN_STR3>;
	};

  - pin settings for the powerdown retention
	sdmmc_pwr_pin: sdmmc-pwr-pin {
		nexell,pin-pwr-domain = <NX_PIN_PWR_DOMAIN_SDMMC>;
		nexell,pins = "gpioa-29", "gpioa-30", "gpioa-31", "gpiob-0",
			      "gpiob-1", "gpiob-2", "gpiob-3", "gpiob-4",
			      "gpiob-5", "gpiob-6", "gpiob-7", "gpiob-8";
		nexell,pin-pwr-drv = <NX_PIN_PWR_NONE>, ....;
		nexell,pin-pwr-val = <NX_PIN_PWR_RETEN_LOW>, ...;
	};

  - used by client devices
	gmac0:ethernet@... {
		pinctrl-names = "default";
		pinctrl-0 = <&gmac_txd &gmac_rxd &gmac_txen &gmac_mdc
		             &gmac_mdio &gmac_rxclk &gmac_txclk>;
		...
	};

  - used by client devices for the powerdown retention
	&sdmmc_pwr_pin {
		nexell,pin-pwr-drv = <NX_PIN_PWR_NONE>, <NX_PIN_PWR_OUTPUT>;
		nexell,pin-pwr-val = <NX_PIN_PWR_RETEN_LOW>,
				<NX_PIN_PWR_RETEN_HIGH>;
	};
```

## Documentation/devicetree/bindings/pwm/pwm-nxp3220.txt
```
Nexell nxp3220 NAND PWM

Required properties:
- compatible : "nexell,nxp3220-pwm".
- reg : Offset and length of the register set for the controller device.
- clocks : shall reference PWM controller clocks.
- clock-names : nand controller internal clock names. Shall contain :
    * "pwm_tclk0" - pwm0 clock source
    * "pwm_tclk1" - pwm1 clock source
    * "pwm_tclk2" - pwm2 clock source
    * "pwm_tclk3" - pwm3 clock source
- #pwm-cells: should be 3. See pwm.txt in this directory for a description of
  the cells format. The only third cell flag supported by this binding is
  PWM_POLARITY_INVERTED.

Optional properties:
- nexell,pwm-outputs: list of PWM channels used as PWM outputs on particular
    platform - an array of up to 4 elements being indices of PWM channels
    (from 0 to 3)

Example:
	// ch: 0 -> skip
	// ch: 1 -> tclk_freq[1] = 100000000;
	// ch: 2 -> skip
	// ch: 3 -> tclk_freq[3] = 100000000;

	pwm: pwm@20880000 {
		compatible = "nexell,nxp3220-pwm";
		reg = <0x20880000 0x400>;
		clocks = <&cmu CLK_PWM0_APB>,
			 <&cmu CLK_PWM0_TCLK0>,
			 <&cmu CLK_PWM0_TCLK1>,
			 <&cmu CLK_PWM0_TCLK2>,
			 <&cmu CLK_PWM0_TCLK3>;
		clock-names = "pwm_apb", "pwm_tclk0", "pwm_tclk1", "pwm_tclk2",
			      "pwm_tclk3";
		nexell,pwm-outputs = <1>, <3>;
		tclk_freq = <100000000>, <100000000>;
		pinctrl-names = "default";
		pinctrl-0 = <&pwm0_pin &pwm1_pin &pwm2_pin &pwm3_pin>;

		assigned-clocks = <&cmu CLK_PWM0_APB>;
		assigned-clock-rates = <166000000>;
     };
```

## Documentation/devicetree/bindings/regulator/sm5011-regulator.txt
```
Binding for Silicon Mitus SM5011 regulators

This is a part of the device tree bindings of SM5011 multi-function device.
More information can be found in ../mfd/sm5011.txt file.

The SM5011 PMIC has 5 Buck converters and 20 LDOs that can be controlled
over I2C.

Following properties should be present in main device node of the MFD chip.

Optional node:
- enable-pwrstm : This boolean value enables PWRSTM feature.
- voltage-regulators : The regulators of sm5011 have to be instantiated
  under subnode named "voltage-regulators" using the following format.

	regulator_name {
		regulator-compatible = LDOn/BUCKn
		standard regulator constraints....
	};
	refer Documentation/devicetree/bindings/regulator/regulator.txt

  The regulator node's name should be initialized with a string
to get matched with their hardware counterparts as follow:

	-LDOn 	:	for LDOs, where n can be in range 1 to 20.
			example: LDO1, LDO2, LDO26.
	-BUCKn 	:	for BUCKs, where n can be in range 2 to 6.
			example: BUCK2, BUCK5, BUCK6.
  sub-node:
	- pwrstm-enter/exit-slot : This integer value indicates the on/off
slot when pmic enter/exit PWRSTM mode. It can be 0 to 3.(4 slots are supported)

Example:

	sm5011: sm5011-pmic@47 {
		compatible = "sm,sm5011";
		interrupt-parent = <&alive_0>;
		interrupts = <1 IRQ_TYPE_NONE>;
		pinctrl-names = "default";
		pinctrl-0 = <&pmic_irq>;
		reg = <0x47>;

		voltage-regulators {
			buck2_reg: BUCK2 {
				regulator-name = "VDD_CPU_1P0";
				regulator-min-microvolt = <562500>;
				regulator-max-microvolt = <2150000>;
				regulator-always-on;
				regulator-boot-on;
				pwrstm-enter-slot = <3>;
				pwrstm-exit-slot = <0>;

				regulator-state-mem {
					regulator-off-in-suspend;
				};
			};

			ldo1_reg: LDO1 {
				regulator-name = "VDD_PLL0_1P0";
				regulator-min-microvolt = <800000>;
				regulator-max-microvolt = <3350000>;
				regulator-always-on;
				regulator-boot-on;
			};
		};
	};
```

## Documentation/devicetree/bindings/rtc/rtc-nexell.txt
```
Nexell RTC(Real Time Clock) Device Tree bindings
=================================================

RTC controller for NEXELL SoCs

Required properties:
- compatible	: must contain "nexell,nx-rtc"
- reg		: the register set (physical address and length) for the RTC
- interrupts	: ths RTC interrupt specifier
- status	: default is "disabled". when using, set to "okay"

Example:
	rtc:rtc@2008c000{
		compatible="nexell,nx-rtc";
		reg=<PHY_BASEADDR_RTC0_MODULE 0x1000>;
		interrupts=<0IRQ_RTC0_MODULE0>;
		status="disabled";
	};
```

## Documentation/devicetree/bindings/soc/nexell/nexell,nxp3220-ecid.txt
```
Nexell nxp3220 ECID Controller
==============================

The nxp3220 ECID Controller provides ecid, guid, chipname.
User can read by /sys interface and function call.

Required properties:
- compatible : "nexell,nxp3220-ecid"
- reg : Offset and length of the register set for the controller device.

Example:
ecid@20060000 {
	compatible = "nexell,nxp3220-ecid";
	reg = <0x20060000 0x1000>;
};
```

## Documentation/devicetree/bindings/sound/nexell-i2s.txt
```
Nexell I2S controller

Required Properties:

- compatible : should be one of the following.
   - nexell,nxp3220-i2s: for 8/16/24bit stereo I2S.
- reg: physical base address of the controller and length of memory mapped
  region.
- dmas: list of DMA controller phandle and DMA request line ordered pairs.
- dma-names: identifier string for each DMA request line in the dmas property.
  These strings correspond 1:1 with the ordered pairs in dmas.
- clocks: Must contain an entry for each entry in clock-names.
- clock-names: Must include the following entries:
 - i2s : i2s core clock name for mclk
 - pclk : i2s internal clock controller
 - pll : i2s core clock's source clock for dynamic sample rate for s5pxx18 soc.
	 It is not used in nxp3220.

Optional Properties:
- pinctrl-0: Should specify pin control groups used for this controller.
- pinctrl-names: Should contain only one value - "default".
- frame-bit : Set frame bit. (16/24/32/48 fs)
- sample-rate : Set sample rate. (8000~192000hz),
		if set this can't dynamic sample rates
- external-mclk-frequency : set external mclk frequency to use in master mode
- supply-mclk-always : supply mclk ouput always (not disable mclk output).
- supply-lrck-always : supply lrck ouput always (not disable lrck output).

Example:

i2s0: i2s0@20078000 {
	compatible = "nexell,nxp3220-i2s";
	reg = <0x20780000 0x1000>;
	clocks = <&cmu CLK_I2S0_CORE>, <&cmu CLK_I2S0_APB>;
	clock-names = "i2s", "pclk";
	dmas = <&pdma0 5 &pdma0 4>;
	dma-names = "tx", "rx";
	pinctrl-names = "default";
	pinctrl-0 = <&i2s0_bus>;
	status = "disabled";
};
```
