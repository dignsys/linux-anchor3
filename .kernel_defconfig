## Documentation/devicetree/bindings/clock/nexell,nxp3220-clock.txt
```
Nexell NXP3220 CMU (Clock Management Units)

The nxp3220 clock controller generates clocks to various peripherals of nxp3220
SoC. It is consist of multiple PLLs and CMUs.

* List of PLLs
- PLL0
- PLL1
- PLL_CPU
- PLL_DDR0
- PLL_DDR1

* List of CMUs
- CMU_SRC: main clock sources across CMU_SYS/CPU/DDR/USB/MM
- CMU_SYS: system clocks
- CMU_CPU: cpu clocks
- CMU_DDR: ddr memory clocks
- CMU_USB: usb clocks
- CMU_MM: multimedia clocks

Required Properties:
- compatible: should be one of the following.
 - "nexell,nxp3220-cmu"		: CMU_SRC + CMU_SYS
 - "nexell,nxp3220-cmu-cpu"	: CMU_CPU
 - "nexell,nxp3220-cmu-ddr"	: CMU_DDR
 - "nexell,nxp3220-cmu-usb"	: CMU_USB
 - "nexell,nxp3220-cmu-mm"	: CMU_MM

- reg:		Specifies base physical address and size of the registers
 (Note: nexell,nxp3220-cmu should specify two memory regions which are for
  CMU_SRC and CMU_SYS)
- #clock-cells: should be 1.
- #reset-cells: should be 1.
- clocks:	phandles to the parent clocks used as input to the module.
- clock-names:	clock names of the parent clocks which described in
		clock-bindings.txt.

	Input clocks for the nxp3220-cmu
		- "oscclk"
		- "pll0"
		- "pll1"
		- "div_cpu_pll"
		- "div_pll_ddr0"
		- "div_pll_ddr1"

	Input clocks for the nxp3220-cmu-cpu
		- "pll_cpu"

	Input clocks for the nxp3220-cmu-ddr
		- "pll_ddr0"
		- "pll_ddr1"

	Input clocks for the nxp3220-cmu-usb
		- "src_usb0_ahb"

	Input clocks for the nxp3220-cmu-mm
		- "src_mm0_axi"
		- "src_vip0_padout0"
		- "src_vip0_padout1"
		- "src_dpc0_x2"
		- "src_lvds0_vclk"
		- "src_coda960_0_core"

Each clock can be assigned its identifier and a clock consumer client can use
the identifier with cmu's phandle. All available clock identifiers are defined
in include/dt-bindings/clock/nxp3220-clk.h>

Similarly reset IDs of each clocks can be found in
include/dt-bindings/reset/nexell,nxp3220-reset.h

Example 1: Examples of 'oscclk' source clock node
	oscclk: xti {
		compatible = "fixed-clock";
		#clock-cells = <0>;
		clock-output-names = "oscclk";
		clock-frequency =  <24000000>;
	};

Example 2: Examples of pll clocks
	pll_0: pll0 {
		compatible = "nexell,pll2555", "syscon";
		reg = <0x27020000 0x60>;

		#clock-cells = <1>;
		clocks = <&oscclk>;
		clock-output-names = "pll0";
	};

	pll_1: pll1 {
		compatible = "nexell,pll2651", "syscon";
		reg = <0x27030000 0x60>;

		#clock-cells = <1>;
		clocks = <&oscclk>;
		clock-output-names = "pll1";
	};

	pll_cpu: pll-cpu {
		compatible = "nexell,pll2555", "syscon";
		reg = <0x22070000 0x60>;

		#clock-cells = <1>;
		clocks = <&oscclk>;
		clock-output-names = "pll_cpu";
	};

	pll_ddr0: pll-ddr0 {
		compatible = "nexell,pll2555", "syscon";
		reg = <0x23070000 0x60>;

		#clock-cells = <1>;
		clocks = <&oscclk>;
		clock-output-names = "pll_ddr0";
	};

	pll_ddr1: pll-ddr1 {
		compatible = "nexell,pll2651", "syscon";
		reg = <0x23070000 0x60>;

		#clock-cells = <1>;
		clocks = <&oscclk>;
		clock-output-names = "pll_ddr1";
	};

Example 3: Examples of clock controllers
	cmu: clock-controller@27000000 {
		compatible = "nexell,nxp3220-cmu";
		reg = <0x27000000 0x8000>,
		    <0x27010000 0x8000>;
		#clock-cells = <1>;

		clock-names = "oscclk",
			"pll0",
			"pll1",
			"div_cpu_pll",
			"div_pll_ddr0",
			"div_pll_ddr1";
		clocks = <&oscclk>,
		       <&pll_0>,
		       <&pll_1>,
		       <&cmu_cpu CLK_CPU_DIV_PLL>,
		       <&cmu_ddr CLK_DDR_DIV_PLL_DDR0>,
		       <&cmu_ddr CLK_DDR_DIV_PLL_DDR1>;
	};

	cmu_cpu: clock-controller@22000000 {
		compatible = "nexell,nxp3220-cmu-cpu";
		reg = <0x22000000 0x800>;
		#clock-cells = <1>;

		clock-names = "pll_cpu";
		clocks = <&pll_cpu>;
	};

	cmu_ddr: clock-controller@23000000 {
		compatible = "nexell,nxp3220-cmu-ddr";
		reg = <0x23000000 0x1000>;
		#clock-cells = <1>;

		clock-names = "pll_ddr0",
			"pll_ddr1";
		clocks = <&pll_ddr0>,
		       <&pll_ddr1>;
	};

	cmu_usb: clock-controller@24000000 {
		compatible = "nexell,nxp3220-cmu-usb";
		reg = <0x24000000 0x400>;
		#clock-cells = <1>;

		clock-names = "src_usb0_ahb";
		clocks = <&cmu CLK_SRC_USB0_AHB>;
	};

	cmu_mm: clock-controller@25000000 {
		compatible = "nexell,nxp3220-cmu-mm";
		reg = <0x25000000 0x1000>;
		#clock-cells = <1>;

		clk-names = "src_mm0_axi",
			"src_vip0_padout0",
			"src_vip0_padout1",
			"src_dpc0_x2",
			"src_lvds0_vclk",
			"src_coda960_0_core";
		clocks = <&cmu CLK_SRC_MM0_AXI>,
		       <&cmu CLK_SRC_VIP0_PADOUT0>,
		       <&cmu CLK_SRC_VIP0_PADOUT1>,
		       <&cmu CLK_SRC_DPC0_X2>,
		       <&cmu CLK_SRC_LVDS0_VCLK>,
		       <&cmu CLK_SRC_CODA960_0_CORE>;
	};

Example 3: UART controller node that consumes the clock generated by the clock
	   controller.

	uart0: serial@20400000 {
		compatible = "snps,dw-apb-uart";
		reg = <0x20400000 0x1000>;
		reg-shift = <2>;
		reg-io-width = <4>;
		clocks = <&cmu CLK_UART0_CORE>,
		       <&cmu CLK_UART0_APB>;
		clock-names = "baudclk", "apb_pclk";
		status = "disabled";
	};
```

## Documentation/devicetree/bindings/clock/nexell,pll.txt
```
Binding for Nexell PLL(2555, 2651) and  fixed-factor-clock controllers

Required Properties:
- compatible: should be one of the following.
 - "nexell,pll2555"		: PLL2555
 - "nexell,pll2651"		: PLL2651
 - "nexell,fixed-factor-clock"  : fixed-factor-clock
- reg: Base address and size of the PLL memory area
- clocks: phandle of the external reference clock
- #clock-cells: should be 1.

Optional properties:
- clock-output-names: can be "pll0", "pll1", "pll_cpu", "pll_ddr0", "pll_ddr1"
		      and fixed-factor-clock "ext_clk", "pll1_div", "pll_cpu_div",
		      "pll_ddr0_div", "pll_ddr1_div"
PLL assigned:
- pll0 : assigned for system bus and io devices,
         system bus freq is pll0/3 and max freq is 333Mhz
- pll1/pll1_div : assigned for audio master clock 12.288 Mhz
		  (sample rate is 16/48/92 Khz)
- pll_cpu/pll_cpu_div : assigned for cpu frequency scaling
- pll_ddr0/pll_ddr0_div : assigned for DDR memory clock
- pll_ddr1/pll_ddr1_div : assigned for audio master clock 16.9344 Mhz
		  (sample rate is 44.1 Khz)

Example:
	pll_0: pll0 {
		compatible = "nexell,pll2555", "syscon";
		reg = <0x27020000 0x60>;
		#clock-cells = <1>;
		clocks = <&oscclk>;
		clock-output-names = "pll0";
		assigned-clocks = <&pll_0 0>;
		assigned-clock-rates = <1000000000>;
	};

	pll_1: pll1 {
		compatible = "nexell,pll2651", "syscon";
		reg = <0x27030000 0x60>;
		#clock-cells = <1>;
		clocks = <&oscclk>;
		clock-output-names = "pll1";
	};

	pll_1_div: pll1-div {
		compatible = "nexell,fixed-factor-clock";
		#clock-cells = <0>;
		clock-div = <2>;
		clock-mult = <1>;
		clock-flags = <CLK_SET_RATE_PARENT>;
		clocks = <&pll_1 0>;
		clock-output-names = "pll1_div";

		assigned-clocks = <&pll_1 0>;
		assigned-clock-rates = <1228800000>;
	};

	pll_cpu: pll-cpu {
		compatible = "nexell,pll2555", "syscon";
		reg = <0x22070000 0x60>;
		#clock-cells = <1>;
		clocks = <&oscclk>;
		clock-output-names = "pll_cpu";
	};

	pll_cpu_div: pll-cpu-div {
		compatible = "nexell,fixed-factor-clock";
		#clock-cells = <0>;
		clock-div = <1>;
		clock-mult = <1>;
		clock-flags = <CLK_SET_RATE_PARENT>;
		clocks = <&pll_cpu 0>;
		clock-output-names = "pll_cpu_div";
		assigned-clocks = <&pll_cpu 0>;
		assigned-clock-rates = <800000000>;
	};

	pll_ddr0: pll-ddr0 {
		compatible = "nexell,pl2555", "syscon";
		reg = <0x23070000 0x60>;
		#clock-cells = <1>;
		clocks = <&oscclk>;
		clock-output-names = "pll_ddr0";
	};

	pll_ddr0_div: pll-ddr0-div {
		compatible = "nexell,fixed-factor-clock";
		#clock-cells = <0>;
		clock-div = <2>;
		clock-mult = <1>;
		clock-flags = <CLK_SET_RATE_PARENT>;
		clocks = <&pll_ddr0 0>;
		clock-output-names = "pll_ddr0_div";
	};

	pll_ddr1: pll-ddr1 {
		compatible = "nexell,pll2651", "syscon";
		reg = <0x23070000 0x60>;

		#clock-cells = <1>;
		clocks = <&oscclk>;
		clock-output-names = "pll_ddr1";
	};

	pll_ddr1_div: pll-ddr1-div {
		compatible = "nexell,fixed-factor-clock";
		#clock-cells = <0>;
		clock-div = <2>;
		clock-mult = <1>;
		clocks = <&pll_ddr1 0>;
		clock-flags = <CLK_SET_RATE_PARENT>;
		clock-output-names = "pll_ddr1_div";

		assigned-clocks = <&pll_ddr1 0>;
		assigned-clock-rates = <1354752000>;
	};
```

## Documentation/devicetree/bindings/devfreq/nxp3220-bus.txt
```
* Nexell NXP3220 Bus frequency device

Required properties for all bus devices:
- compatible: Should be "nexell,nxp3220-bus".
- clock-names : the name of clock used by the bus, "bus".
- clocks : phandles for clock specified in "clock-names" property.
- operating-points-v2: the OPP table including frequency/voltage information
  to support DVFS (Dynamic Voltage/Frequency Scaling) feature.
- bus-names : the name of the bus.

Required properties:
- vdd-supply: the regulator to provide the bus with the voltage.
- devfreq: the parent bus device.

Example :
	sys_bus_opp_table: bus_opp_table0 {
		compatible = "operating-points-v2";
		opp-shared;

		opp-0 {
			opp-hz = /bits/ 64 <100000000>;
			opp-microvolt = <975000>;
		};
		opp-1 {
			opp-hz = /bits/ 64 <166666667>;
			opp-microvolt = <975000>;
		};
		opp-2 {
			opp-hz = /bits/ 64 <333333334>;
			opp-microvolt = <1000000>;
		;
	};

	sys_bus: sys_bus {
		compatible = "nexell,nxp3220-bus";
		bus-name = "sys";
		clocks = <&cmu CLK_SRC_SYS0_AXI>;
		clock-names = "bus";
		operating-points-v2 = <&sys_bus_opp_table>;
		vdd-supply = <&buck5_reg>; /* "VDD_CORE_1P0" */
		status = "okay";
	};
```

## Documentation/devicetree/bindings/display/nexell/lvds.txt
```
Device-Tree bindings for Nexell DRM generic RGB panel output driver

Required properties for display soc panel driver:
- compatible: value should be "nexell,nxp3220-drm-lvds".
- reg: Physical base address and length of the lvds controller's registers.
- clocks: Must contain an entry for each entry in clock-names.
- clock-names: Must include the following entries:
 - vclk : lvds clock name
 - phy : lvds phy clock name

- port: A port node with endpoint definitions as defined in
	Documentation/devicetree/bindings/media/video-interfaces.txt.

- display-timing: typical videomode of lcd panel. Multiple video modes
    can be listed if the panel supports multiple timings, but the 'native-mode'
    should be the preferred/default resolution.  Refer to
    Documentation/devicetree/bindings/display/panel/display-timing.txt
    for display timing binding details.
- width-mm: physical panel width [mm]
- height-mm: physical panel height [mm]

- display-config: sub node to config display sync parameters.
 - out-format: specifies display sync output format
 - invert-field: pecifies internal field polarity
    		   0: normal field(low is odd), 1: invert field(low is even)
 - swap-rb: swap red and blue component for rgb output
 - yc-order: output order for YCbCr Output
 - delay-mask: to adjust delay (rgb_pvd, hsync_cp1, vsync_fram, de_cp2)
    		 if 0, set defalut delays
 - delay-rgb-pvd: the delay value for RGB/PVD signal
 - delay-hs-cp1: the delay value for HSYNC/CP1 signal
 - delay-vs-frame: the delay value for VSYNC/FRAM signal
 - delay-de-cp2: the delay value for DE/CP2 signal
 - vsync-start-offs: start veritcal sync offset
 - vsync-end-offs: end veritcla sync offset
 - evsync-start-offs: start even veritcal sync offset
 - evsync-end-offs: end even veritcal sync offset
 - evfront-porch: even veritcal sync front porch
 - evback-porch: even veritcal sync back porch

- format: lvds format 0: VESA format, 1: JEDIA foramt, 2: user location
- voltage-level: lvds tx driver output differential volatge level
- voltage-output: output offset voltage control

  Valid values for voltage-output:
     - for the nxp3220
     "LVDS_VOL_OFFS_0_8" : 0.8v 
     "LVDS_VOL_OFFS_0_9" : 0.9v 
     "LVDS_VOL_OFFS_1_0" : 1.0v 
     "LVDS_VOL_OFFS_1_1" : 1.0v 

Example:
drm_lvds: drm_lvds@25150000 {
	compatible = "nexell,nxp3220-drm-lvds";
	reg = <0x25150000 0x1000>;
	clocks = <&cmu_mm CLK_MM_LVDS_VCLK>,
	       <&cmu_mm CLK_MM_LVDS_PHY>;
	clock-names = "vclk", "phy";
	resets = <&cmu_mm CLK_RESET_MM_LVDS_PHY>;
	status = "disabled";
};

panel: panel {
        compatible = "samsung,lms700kf23";
        backlight = <&backlight>;
        status = "okay";
	port {
		lvds_panel: endpoint {
			remote-endpoint = <&lvds_out>;
		};
	};
};

&drm_lvds {
        port {
                lvds_out: endpoint {
                        remote-endpoint = <&lvds_panel>;
                };
        };

        display-config {
                out-format = <3>; /* RGB888:3 */
        };
};
```

## Documentation/devicetree/bindings/display/nexell/nexell_drm.txt
```
Device-Tree bindings for Nexell's DRM and display control driver

Required properties:
- compatible: value should be "nexell,nxp3220-drm"
- reg: Physical base address and length of the multi layer controller's
       registers map and display sysnc controller's registers map.
- reg-names: Should be "mlc.0" and "dpc.0".
- interrupts: The interrupt signals from the display sync controller.
- clocks: Must contain an entry for each entry in clock-names.
- clock-names: Must include the following entries:
 - axi : display bus clock name
 - clk_x1 : display X1 sync clock for the operation of a pixel unit
 - clk_x2 : display X2 sync clock for for pixel output.
- plane-names: multi layer's type and order ("primary", "video")

Optional Properties:
- back-color: top layer's background color
- color-key: video layer's color key value
- video-priority: video layer's priority (0: video/primary, 1:primary/video)
- color-key-disable: disable color-key at boot time
- alphablend-disable: disable alpha blend at boot time
- video-scale-hfilter-max: video layer's horizontal line filter enable max limit
                           value, if source image width is greater than or equal
			   this value, disable horizontal line filter.
			   If set to 0, it is automatically set.
- video-scale-vfilter-max: video layer's veritcal line filter enable max limit
                           value, if source image height is greater than or equal
			   this value, disable vertical line filter.
			   If set to 0, it is automatically set.

Example:

drm: drm@25140000 {
	compatible = "nexell,nxp3220-drm";
	reg = <0x25140000 0x1000>, <0x25140800 0x1000>;
	reg-names = "mlc.0", "dpc.0";
	interrupts = <GIC_SPI 38 IRQ_TYPE_NONE>;
	clocks = <&cmu_mm CLK_MM_DPC_AXI>,
		       <&cmu_mm CLK_MM_DPC_X1>,
		       <&cmu_mm CLK_MM_DPC_X2>;
	clock-names = "axi", "clk_x1", "clk_x2";
	plane-names = "primary", "video";
	status = "disabled";
};

&drm {
	status = "okay";
};
```
