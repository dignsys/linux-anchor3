## Documentation/devicetree/bindings/display/nexell/rgb.txt
```
Device-Tree bindings for Nexell DRM generic RGB panel output driver

Required properties for display soc panel driver:
- compatible: value should be "nexell,s5pxx18-drm-rgb".
- syscon: a pointer to the syscon node so we can access the syscon registers
         to set the rgb clocks.
- pinctrl-0: Should specify pin control groups used for this controller.
 - dp_vclk: output pixel clock
 - dp_vsync: output vertical sync
 - dp_hsync: output horizontal sync
 - dp_de: output data enable
 - dp_blue: output RGB blue data
 - dp_green: output RGB green data
 - dp_red: input output RGB red data
- pinctrl-names: Should contain only one value - "default".
- panel-mpu: support mpu type RGB LCD

- port: A port node with endpoint definitions as defined in
	Documentation/devicetree/bindings/media/video-interfaces.txt.

- display-timing: typical videomode of lcd panel. Multiple video modes
    can be listed if the panel supports multiple timings, but the 'native-mode'
    should be the preferred/default resolution.  Refer to
    Documentation/devicetree/bindings/display/panel/display-timing.txt
    for display timing binding details.
- width-mm: physical panel width [mm]
- height-mm: physical panel height [mm]

- display-config: sub node to config display sync parameters.
 - out-format: specifies display sync output format
 - invert-field: pecifies internal field polarity
    		   0: normal field(low is odd), 1: invert field(low is even)
 - swap-rb: swap red and blue component for rgb output
 - yc-order: output order for YCbCr Output
 - delay-mask: to adjust delay (rgb_pvd, hsync_cp1, vsync_fram, de_cp2)
    		 if 0, set defalut delays
 - delay-rgb-pvd: the delay value for RGB/PVD signal
 - delay-hs-cp1: the delay value for HSYNC/CP1 signal
 - delay-vs-frame: the delay value for VSYNC/FRAM signal
 - delay-de-cp2: the delay value for DE/CP2 signal
 - vsync-start-offs: start veritcal sync offset
 - vsync-end-offs: end veritcla sync offset
 - evsync-start-offs: start even veritcal sync offset
 - evsync-end-offs: end even veritcal sync offset
 - evfront-porch: even veritcal sync front porch
 - evback-porch: even veritcal sync back porch

Example:

drm_rgb: drm_rgb@25140000 {
	compatible = "nexell,nxp3220-drm-rgb";
	syscon = <&sys_reg_sys>;
	pinctrl-names = "default";
	pinctrl-0 = <&dp_vclk &dp_vsync &dp_hsync &dp_de &dp_blue &dp_green &dp_red>;
	status = "disabled";
};

panel: panel {
        compatible = "samsung,lms700kf23";
        backlight = <&backlight>;
        status = "okay";
	port {
		rgb_panel: endpoint {
			remote-endpoint = <&rgb_out>;
		};
	};
};

&drm_rgb {
        port {
                rgb_out: endpoint {
                        remote-endpoint = <&rgb_panel>;
                };
        };

        display-config {
                out-format = <3>; /* RGB888:3 */
        };
};
```

## Documentation/devicetree/bindings/display/panel/newhaven,nhd-5.0-800480tf-atxl.txt
```
Newhaven Display International 5" 800 x 480 TFT LCD panel

Required properties:
- compatible: should be "newhaven,nhd-5.0-800480tf-atxl"

This binding is compatible with the simple-panel binding, which is specified
in simple-panel.txt in this directory.
```

## Documentation/devicetree/bindings/iio/adc/nexell_adc.txt
```
Nexell's Analog to Digital Converter (ADC)

The devicetree bindings are for the ADC driver written for Nexell's ADC.

When the sampling is done, interrupt is rised, and then read the value.
Please refer to the datasheet for more information.


Required properties:
  - compatible: Should be "nexell,<chip>-adc"
    <chip> can be "s5p4418", "s5p6818", "nxp3220"
  - reg: Should contain ADC registers location and length
  - interrupts: Should contain the IRQ line for the ADC
  - clocks : From common clock bindings - handles to clocks specified in
        "clock-names" property, in the same order.
  - clock-names: From common clock bindings - list of clock input names used by
        ADC block. Should contain "adc"
  - sample_rate: ADC channel sampling rate. (Max 1MHz according to datasheet)
  - #io-channel-cells: <1> - As ADC has multiple outputs.
        For details about this, see:
            Documentation/devicetree/bindings/iio/iio-bindings.txt
  - touchscreen-enable: Enable the touchscreen feature on the adc controller.

Example:
	adc:adc@20600000 {
		compatible = "nexell,nxp3220-adc";
		reg = <20600000 0x1000>;
		interrupts = <0 IRQ_ADC0_MODULE 0>;
		clocks = <&cmu CLK_ADC0_APB>;
		clock-names = "adc";
		sample_rate = <200000>;
		#io-channel-cells = <1>;
		touchscreen-enable;
	};
```

## Documentation/devicetree/bindings/input/tca9535-keypad.txt
```
* tca9535-keypad device tree bindings

Required Chip Specific Properties:
- compatible: "tca9535-key"
- reg: the i2c address
- interrupts: IRQ line number to the cpu
- ports: pin number to which the key is connected (note the omitted number)
- autorepeat: Enable auto repeat feature
- use-polling: polling key status

- label: descriptive name of the key
- linux,input-type: Specify event type this button/key generates.
  If not specified defaults to <1> == EV_KEY
- linux,code: keycode to emit


Example:

&i2c_1 {
	tca9535: tca9535@20 {
		compatible = "tca9535-key";
		#address-cells = <1>;
		#size-cells = <0>;
		reg = <0x20>;
		interrupt-parent = <&gpio_c>;
		interrupts = <17 GPIO_ACTIVE_LOW>;
		ports = <5 6 7>;

		button@1 {
			label = "key1";
			linux,input-type = <EV_KEY>;
			linux,code = <KEY_1>;
		};

		button@2 {
			label = "key2";
			linux,input-type = <EV_KEY>;
			linux,code = <KEY_2>;
		};

		button@3 {
			label = "key3";
			linux,input-type = <EV_KEY>;
			linux,code = <KEY_3>;
		};
	};
};
```

## Documentation/devicetree/bindings/media/nexell-vpu.txt
```
Device-Tree bindings for Nexell's VPU driver

Required properties:
- compatible: value should be "nexell, nx-vpu"
- reg: Physical base address of the IP registers and length of memory mapped
       region.
- interrupts: The interrupt signals from the vpu.
- clocks: Must contain an entry for each entry in clock-names.
- clock-names: Must include the following entries.

Optional properties:
- memory-region: from reserved memory binding: require one memory region.
  If the property is present, the kernel must be set reserved-memory in dts.
  and must be seletcted VIDEO_NEXELL_RESERVED_MEMORY in kernel configuration.
  If the property is not present, the kernel must be not selected
  VIDEO_NEXELL_RESERVED_MEMORY in kernel configuration.
  ( recommand to use memory-region )

Example:
vpu: vpu@25180000 {
	compatible = "nexell,nx-vpu";
	reg = <0x25180000 0x10000>;
	interrupts = <GIC_SPI 31 IRQ_TYPE_NONE>;
	clocks = <&cmu_mm CLK_MM_CODA960_AXI>,
		<&cmu_mm CLK_MM_CODA960_APB>,
		<&cmu_mm CLK_MM_CODA960_CORE>;
	clock-names = "vpu-clk-axi", "vpu-clk-apb", "vpu-clk-core";
	assigned-clocks = <&cmu_mm CLK_MM_CODA960_CORE>;
	assigned-clock-rates = <250000000>;
	status = "disabled";
};

- in the case of using reserved-memory
reserved-memory {
	#address-cells = <1>;
	#size-cells = <1>;
	ranges;

	vpu_cma: region_vpu_cma {
		compatible = "shared-dma-pool";
		reusable;
		size = <0x8000000>;
		/* linux,cma-default; */
	};
};

&vpu {
	memory-region = <&vpu_cma>;
	status = "okay";
};

- in the case of unusing reserved-memory
&vpu {
	status = "okay";
};
```

## Documentation/devicetree/bindings/media/nxp3220-clipper.txt
```
Nexell V4L2 Clipper Device Tree bindings
========================================

Clipper clip vip input data and give data to decimator and
save clipped data to memory.
The DT definitions can be found in include/dt-bindings/media/nxp3220-vip.h

Required properties:
- compatible	: must contain "nexell,nxp3220-clipper"
- module	: vip module number
- interface_type	: NX_CAPTURE_INTERFACE_PARALLEL or NX_CAPTURE_INTERFACE_MIPI
			  parallel interface is 8bit(656/601)
- pinctrl-names	: must contain "default"
- pinctrl-0	: the pinctrl reference to vid
- port		: vip input port, each vip has two input port and can use only one
- external_sync	: if 1, this is 601, else 656
- data_order	: YUV 422 data order from camera sensor
- interlace	: if 1, interlace input data
- sensor: type	: must contain NX_CAPTURE_SENSOR_I2C
- sensor: sensor_name	: camera sensor name
- sensor: i2c_bus	: i2c reference device tree node
- sensor: addr		: camera sensor i2c address

Optional properties:
- power: enable_seq	: camera sensor power on sequence
			  [ACTION_START_TAG][ACTION_TYPE][SEQUENCE][ACTION_END_TAG]
			  ACTION_START_TAG : NX_ACTION_START
			  ACTION_END_TAG : NX_ACTION_END
			  ACTION_TYPE : NX_ACTION_TYPE_PMIC, NX_ACTION_TYPE_GPIO, NX_ACTION_TYPE_CLOCK
			  SEQUENCE for ACTION_TYPE_GPIO: gpionum, value, delay_ms, value, delay_ms ...
			  SEQUENCE for ACTION_TYPE_PMIC: regulator_name, value, delay_ms
			  SEQUENCE for ACTION_TYPE_CLOCK: enable/disable, delay_ms
- power: disable_seq	: camera sensor power off sequence
                          Action defines same to above
- clock: pwms	: reference to pwm that gives master clock to camera sensor

Example:
	clipper {
		compatible = "nexell,nxp3220-clipper";
		module = <0>;
		interface_type = <NX_CAPTURE_INTERFACE_PARALLEL>;
		pinctrl-names = "default";
		pinctrl-0 = <&vid_data_clk &vid_sync>;
		port = <1>;
		external_sync = <0>;
		data_order = <NX_VIN_CBY0CRY1>;
		interlace = <1>;

		sensor {
			type = <NX_CAPTURE_SENSOR_I2C>;
			sensor_name = "tw9900";
			i2c-bus = <&i2c_1>;
			addr = <0x44>;
		};

		power {
			enable_seq = <
				NX_ACTION_START NX_ACTION_TYPE_PMIC 0 0 NX_ACTION_END
				NX_ACTION_START NX_ACTION_TYPE_PMIC 1 0 NX_ACTION_END
				NX_ACTION_START NX_ACTION_TYPE_GPIO 102 1 0 NX_ACTION_END
				NX_ACTION_START NX_ACTION_TYPE_GPIO 103 1 0 0 1 NX_ACTION_END
				NX_ACTION_START NX_ACTION_TYPE_GPIO 104 0 0 1 0 NX_ACTION_END
				NX_ACTION_START NX_ACTION_TYPE_CLOCK 1 10 NX_ACTION_END
				NX_ACTION_START NX_ACTION_TYPE_GPIO 104 0 10 NX_ACTION_END
				NX_ACTION_START NX_ACTION_TYPE_GPIO 103 1 5 NX_ACTION_END
				>;
		};

		clock {
			pwms = <&pwm_device1 0 24000000 0>
		};
	};
```

## Documentation/devicetree/bindings/media/nxp3220-decimator.txt
```
Nexell V4L2 Device Tree bindings
================================

Decimator can scale down input image and saves to memory.
Normally this function is same to pip-preview function.

Required properties:
- compatible	: must contain "nexell,nx3220-decimator"
- module	: vip module number
- status	: to enable, must contain "okay"

Example:
	decimator {
		compatible = "nexell,nx3220-decimator";
		module = <0>;
		status = "okay";
	};
```

## Documentation/devicetree/bindings/media/nxp3220-deinterlacer.txt
```
Nexell Deinterlacer Device Tree bindings
=========================================

Deinterlacer is Deinterlacing to process of converting interlaced video,
such as common analog television signal.

Required properties:
- compatible		: must contain "nexell,nxp3220-deinterlacer"
- reg			: the two register sets (physical address and length) for the DEINTERLACER
- interrupts		: ths DEINTERLACER interrupt specifier
- assigned-clocks	: Bus clock assigned
- assigned-clock-rates  : Speed of the assigned bus clock
- clock-names		: the DEINTERLACER clock specifier
- clocks		: the clock reference for DEINTERLACER. must use value defined in clock dts
- module		: the DEINTERLACER module number
- status		: default is "disabled". when using, set to "okay"

Example:
	deinterlacer: deinterlacer@0x250c0000 {
		compatible ="nexell,nxp3220-deinterlacer";
		reg = <0x250C0000 0x1000>;
		interrupts = <GIC_SPI 33 IRQ_TYPE_NONE>;
		assigned-clocks = <&cmu_mm CLK_MM_DEINTERLACE_AXI>,
			<&cmu_mm CLK_MM_DEINTERLACE_APB>;
		assigned-clock-rates = <333333334>, <166666667>;
		clock-names = "axi","apb";
		clocks = <&cmu_mm CLK_MM_DEINTERLACE_AXI>,
			<&cmu_mm CLK_MM_DEINTERLACE_APB>;
		status = "disabled";
	};
```

## Documentation/devicetree/bindings/media/nxp3220-vip.txt
```
Nexell V4L2 VIP Device Tree bindings
====================================

VIP is Video Input Processor.
The DT definitions can be found in include/dt-bindings/media/nxp3220-vip.h

Required properties:
- compatible	: must contain "nexell,nxp3220-vip"
- reg		: the two register sets (physical address and length) for the VIP
- interrupts	: ths VIP interrupt specifier
- clock-names	: the VIP clock specifier
- clocks	: the clock reference for VIP. must use value defined in clock dts
- resets	: the reset reference for VIP. must use value defined in reset dts
- module	: the VIP module number
- status	: default is "disabled". when using, set to "okay"

Example:
	vip: vip@25100000 {
		compatible = "nexell,nxp3220-vip";
		reg = <0x25100000 0x1000>;
		interrupts = <GIC_SPI 124 IRQ_TYPE_NONE>;
		clock-names = "vip_axi", "vip_apb";
		clocks = <&cmu_mm CLK_MM_VIP_AXI>,
		       <&cmu_mm CLK_MM_VIP_APB>;
		module = <0>;
		status = "okay";
	};
```

## Documentation/devicetree/bindings/mfd/sm5011.txt
```
Silicon Mitus SM5011 multi-function device

SM5011 is a multifunction device which can be operated as PMIC, RTC, 32kHz
clock provider and Watchdog reset timer. It is interfaced with a host
controller using i2c interface.

Required properties:
- compatible : Must be "sm,sm5011";
- reg : 0x47 which is the i2c slave address of PMIC block.
- interrupts : This i2c device has an IRQ line connected to the main SoC.
- interrupt-parent : The parent interrupt controller.
- pinctrl-names: pinctrl name of the interrupt line, "default"
- pinctrl-0: specifies a pinctrl node of the interrupt line

Example:
	sm5011: sm5011-pmic@47 {
		compatible = "sm,sm5011";
		interrupt-parent = <&alive_0>;
		interrupts = <1 IRQ_TYPE_NONE>;
		pinctrl-names = "default";
		pinctrl-0 = <&pmic_irq>;
		reg = <0x47>;
	};
```

## Documentation/devicetree/bindings/mmc/nexell-dw-mshc.txt
```
* Nexell NXP3220 specific extensions to the Synopsys Designware Mobile
  Storage Host Controller

The Synopsys designware mobile storage host controller is used to interface
a SoC with storage medium such as eMMC or SD/MMC cards. This file documents
differences between the core Synopsys dw mshc controller properties described
by synopsys-dw-mshc.txt and the properties used by the Nexell nxp3220 specific
extensions to the Synopsys Designware Mobile Storage Host Controller.

Required Properties:

* compatible: should be
	- "nexell,nxp3220-dw-mshc" : for controllers with nexell nxp3220.

* nexell,drive_shift : Output drive clock phase shift. range is 0 ~ 7
* nexell,sample_shift : Read sample clock phase shift. range is 0 ~ 7.

* clock-names: input names of clocks used by the controller:
  - "biu" - controller bus clock,
  - "ciu" - cortrpller out clock.

- clocks: phandles and specifiers for all clocks specified in "clock-names"
  property, in the same order, according to clock bindings documentation [2].

[1] Documentation/devicetree/bindings/interrupt-controller/interrupts.txt
[2] Documentation/devicetree/bindings/clock/clock-bindings.txts

Nodes fot nexell clock timing value:
 - drive_dly, sample_dly : 1 step delay 1.2usec.
 - drive_shift, sample_shift :  1 step shuft 90 degree.

Optional properties:
- soc,tieoff : phandle to the tieoff control.
 use 8bit bus width ch2. Must set  1 NX_TIEOFF_MMC_8BIT Tieoff.

Example:
  The MSHC controller node can be split into two portions, SoC specific and
  board specific portions as listed below.
in dtsi:
	dw_mmc0: dw_mmc@26080000 {
		compatible = "nexell,nxp3220-dw-mshc";
		interrupts = <GIC_SPI 82 IRQ_TYPE_NONE>;
		#address-cells = <1>;
		#size-cells = <0>;
		reg = <0x26080000 0x1000>;
		clock-frequency = <400000000>;
		clock-names = "biu", "ciu";
		clocks = <&cmu CLK_SDMMC0_AHB>,
		      <&cmu CLK_SDMMC0_CORE>;
		num-slots = <1>;
		bus-width = <8>;
		pinctrl-names = "default";
		pinctrl-0 = <&mmc0_bus>;
		fifo-depth = <0x20>;
		status = "disabled";
	};

in xxx.dts

	&dw_mmc0 {
		cap-mmc-highspeed;
		broken-cd;
		non-removable;
		nexell,drive_shift = <0x03>;
		nexell,sample_shift = <0x01>;
		card-detect-delay = <200>;
		disable-wp;
		status = "okay";
	};
```
