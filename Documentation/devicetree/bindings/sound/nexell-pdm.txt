## drivers/gpu/drm/nexell/Kconfig
```kconfig
config DRM_NEXELL
	tristate "DRM Support for NEXELL Display Controller"
	depends on DRM && (ARCH_NXP3220 || ARCH_NXP3225)
	select DRM_KMS_HELPER
	select DRM_KMS_FB_HELPER
	select DRM_GEM_CMA_HELPER
	select VIDEOMODE_HELPERS
	select FB_SYS_FILLRECT
	select FB_SYS_COPYAREA
	select FB_SYS_IMAGEBLIT
	select VT_HW_CONSOLE_BINDING if FRAMEBUFFER_CONSOLE
	select DRM_NEXELL_GEM
	help
	  Choose this option if you have a Nexell soc chipset.
	  This driver provides kernel mode setting and buffer
	  management to userspace. If M is selected the module
	  will be called nexell drm.

config DRM_CHECK_AUTHENTICATION
        bool "Check Authentication for modesetting driver"
        depends on DRM_NEXELL
        default y
        help
         Choose this option if you need check authentication
         for modesetting driver

          If in doubt, say "Y".

config DRM_NEXELL_GEM
	bool

config DRM_NEXELL_GEM_SYSTEM
        bool "Nexell gem supports system memory allocation"
        depends on DRM_NEXELL
        default n
        help
	 Choose this if you need the NEXELL GEM SYSTEM.
	 NEXELL GEM allocates buffer in CMA or system memory for non-contiguous,
	 cached memory. If this option is not selected, drm allocates buffer
	 in CMA memory.

config DRM_PRE_INIT_DRM
        bool "Don't reinitialize, use bootloader's Display configuration"
        depends on DRM_NEXELL
        default n
        help
	 Select this option if display contents should be inherited as set by
	 the bootloader.

config DRM_NEXELL_G2D
        bool "Graphic 2D Accelator"
        depends on DRM_NEXELL && ARCH_NXP3220_COMMON
        default y
        help
	 Choose this option if you want to use NXP3220 Graphic 2D Accelator(G2D)
         for DRM.

config DRM_NEXELL_RGB
	bool "RGB LCD support"
	depends on DRM_NEXELL
	select DRM_PANEL
	help
	 This selects support for RGB LCD display out.
	 If you want to enable RGB LCD display,
	 you should selet this option.

config DRM_NEXELL_LVDS
	bool "LVDS LCD support"
	depends on DRM_NEXELL
	select DRM_PANEL
	help
	 This selects support for LVDS LCD display out.
	 If you want to enable LVDS LCD display,
	 you should selet this option.
```

## drivers/media/platform/nexell/Kconfig
```kconfig
config VIDEO_NEXELL
	bool "Nexell SoC series V4l2 Subsystem driver"
	depends on VIDEO_V4L2 && VIDEO_V4L2_SUBDEV_API
	depends on ARCH_NXP3220 || ARCH_NXP3225 || COMPILE_TEST
	depends on OF && COMMON_CLK
	depends on RESET_CONTROLLER
	select VIDEOBUF2_DMA_CONTIG
	help
	  Say Y here to enable Nexell video devices for Nexell SoC.
	  This subsystem includes capture devices. Nexell V4L2 drivers supports
	  only dmabuf type.

config VIDEO_NXP3220_CAPTURE
	bool "Nexell NXP3220 SoC series camera interface driver"
	depends on I2C && VIDEO_NEXELL
	default n
	help
	  This is a V4L2 driver for Nexell NXP3220 SoC camera host
	  interface. Nexell camera device has two memory interfaces, one is
	  clipper and other is decimator. clipper can crop source region
	  and decimator can scale down but cannot scale up.

	  Camera host interface has three physical interface with sensor.
	  Two of them are parallel and support ITU-R BT.656 and BT.601 and
	  BT.1120.

source "drivers/media/platform/nexell/capture/Kconfig"

config VIDEO_NXP3220_M2M
	bool "Nexell NXP3220 M2M interface driver"
	default n
	help
	  This is the interface driver for Nexell NXP3220 SoC for the M2M
	  device. These are devices that read data form the source memory and
	  then reprocess and output the result to the destinatoi memory.

	  Say Y here to enable Nexell M2M deivces.

source "drivers/media/platform/nexell/m2m/Kconfig"
```

## drivers/media/platform/nexell/capture/Kconfig
```kconfig
config VIDEO_NXP3220_CLIPPER
	bool "Enable capture clipper video device"
	depends on VIDEO_NXP3220_CAPTURE
	default n
	---help---
	 Say y here to enable Nexell NXP3220 SoC VIP clipper video device.
	 Clipper video device can crop source crop and has memory interface.
	 If you want to enable only clipper subdev, don't check this.

config VIDEO_NXP3220_DECIMATOR
	bool "Enable capture decimator video device"
	depends on VIDEO_NXP3220_CAPTURE
	default n
	---help---
	 Say y here to enable Nexell NXP3220 SOC VIP decimator video device.
	 Decimator video device can scale down and has memory interface.
```

## drivers/media/platform/nexell/m2m/Kconfig
```kconfig
config VIDEO_NXP3220_DEINTERLACER
	bool "Enable deinterlacer"
	depends on (ARCH_NXP3220 || ARCH_NXP3225) && VIDEO_NXP3220_M2M
	default n
	help
	  This is a deinterlace driver for Nexell NXP3220 Soc. The deinterlace
	  block makes a frame data by using a field(Odd/Even) data.
	  If the current field of the iamge is an even field, the creates
	  a new odd field by using the previous odd field
	  and the next odd field.

	  Say y here to enable deinterlacer
```

## drivers/phy/nexell/Kconfig
```kconfig
#
# Phy drivers for Nexell platforms
#
config PHY_NEXELL_USB2
	tristate "Nexell USB2 PHY driver"
	depends on ARCH_NEXELL
	select GENERIC_PHY
	help
	  Enable this to support the Nexell USB 2.0 PHY driver for Nexell
	  SoCs. This driver provides the interface for USB 2.0 PHY.

config PHY_NXP3220_USB2
        bool "Support for NXP3220"
        depends on PHY_NEXELL_USB2
```

## drivers/pinctrl/nexell/Kconfig
```kconfig
#
# NEXELL Pin control drivers
#
config PINCTRL_NEXELL
	bool
	select PINMUX
	select PINCONF

config PINCTRL_NEXELL_NXP3220
	bool "Nexell nxp3220 SoC pinctrl driver"
	depends on ARCH_NEXELL
	select PINCTRL_NEXELL
	help
	  This pinctrl driver provides an interface that allows configuring
	  of NEXELL nxp3220 pins and using them as GPIOs.
```

## drivers/soc/nexell/Kconfig
```kconfig
#
# Nexell SoC drivers
#
if ARCH_NXP3220 || ARCH_NXP3225
source "drivers/soc/nexell/nxp3220/Kconfig"
endif
```

## sound/soc/nexell/Kconfig
```kconfig
config SND_NEXELL
	tristate "Nexell SoC Audio"
	depends on ARCH_NEXELL
	help
	  Say Y or M if you want to add support for codecs attached to
	  the I2S and spdif and others interface.

config SND_NEXELL_PCM
	bool

config SND_NEXELL_I2S
	tristate "Nexell I2S"
	depends on SND_NEXELL
	select SND_NEXELL_PCM

config SND_NEXELL_PDM
	tristate "Nexell PDM"
	depends on SND_NEXELL

config SND_NEXELL_NULL_CODEC
	tristate "Nexell Null Codec"
	depends on SND_NEXELL
```
