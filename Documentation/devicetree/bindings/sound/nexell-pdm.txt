## Documentation/devicetree/bindings/sound/nexell-pdm.txt
```
Nexell PDM controller

Required Properties:
- compatible : should be one of the following.
               nexell,nxp3220-pdm: for 16bit 4 channel pdm to pcm.

- reg: physical base address and size of the pdm registers map and
	pdm internal sram.
- reg-names: Should be "pdm" and "sram".
- clocks: Must contain an entry for each entry in clock-names.
- clock-names: Must include the following entries:
 - axi : pdm bus clock name
 - core : pdm internal clock controller and make strobe clock.
- interrupts: Interrupt specifier for the PDM Peripheral/DMA
- syscon: a pointer to the syscon node so we can access the syscon registers
	 to set the iis reference channels.
- pinctrl-0: Should specify pin control groups used for this controller.
 - pdm_strobe: output clock for external digital mic.
 - pdm_lr0: input data for pad 0's Left / Right channel
 - pdm_lr1: input data for pad 1's Left / Right channel
 - pdm_lr2: input data for pad 2's Left / Right channel
 - pdm_lr3: input data for pad 3's Left / Right channel
- pinctrl-names: Should contain only one value - "default".

Optional Properties:
- ref-iis: set iis reference channel number to synchronize with pdm data.
- ref-sample-rate: set iis's sample rate to synchronize with pdm data.
- sample-rate: pdm to pcm sample rate. support 8,16,32,48khz
- strobe-hz: the strobe clock frequency applied to mic.
- filter-coeff: pdm's filter coefficient nodes and values.
- select-pads: The PDM input channel is 8 channels (pdm_lr0/1/2/3),
               but the PDM operates only 4 channels with 2 pads,
	       you can select input pads number.
- assigned-core-freqeuncy: skip pdm core clock set, use default core clock.

Example:

pdm: pdm0@20c00000 {
	compatible = "nexell,nxp3220-pdm";
	#sound-dai-cells = <0>;
	reg = <0x20c00000 0x1000>, <0x20c04000 0x4000>;
	reg-names = "pdm", "sram";
	clocks = <&cmu CLK_PDM0_AXI>,
		<&cmu CLK_PDM0_CORE>;
	clock-names = "axi", "core";
	interrupts = <GIC_SPI 67 IRQ_TYPE_NONE>;
	pinctrl-0 = <&pdm_strobe>, <&pdm_lr0>, <&pdm_lr1>;
	pinctrl-names = "default";
	syscon = <&sys_reg_sys>;
	status = "disabled";
};

&pdm {
	sample-rate = <16000>;
	assigned-clocks = <&cmu CLK_PDM0_AXI>;
	assigned-clock-rates = <200000000>;
	status = "okay";
};
```

## Documentation/devicetree/bindings/spi/spi-dw-nexell.txt
```
Synopsys DesignWare AMBA 2.0 Synchronous Serial Interface for NXP3220.

Required properties:
- compatible : "nexell,nxp3220-dw-spi"
- reg : The register base for the controller.
- interrupts : One interrupt, used by the controller.
- clcoks : Must contain one entry, for the module clock.
- spi-mode : Sets whether SPI operates in normal, dual, quad,
	     and octal modes.
	     Normal : 0x0,
	     Dual   : 0x1,
	     Quad   : 0x2,
	     Octal  : 0x3
- pinctrl-names : Uses "default", can use "sleep" if provided
                   See ../pinctrl/pinctrl-binding.txt
- pinctrl-0 : pin control group to be used for this controller.

Optional properties:
- cs-gpios : Specifies the gpio pis to be used for chipselects.
- dmas : DMA specifier, consisting of a phandle to DMA controller node
- dma-names : Names for the dma channels
- num-cs : The number of chipselects. If omitted, this will default to 4.
- reg-io-width : The I/O register width (in bytes) implemented by this
  device.  Supported values are 2 or 4 (the default).
- resets : phandle of the internal reset line
- slave-sel-offset : Register offset to configure slave mode
- spi-slave : make spi to slave mode
- spi-dma: Set to run dma mode if transfer size is bigger than fifo length.
- syscon : a pointer to the syscon node so we can access the syscon registers
          to set the slave mode.
- status : Set node status. disabled or okay

Child nodes as per the generic SPI binding.

In sub node with m25p90 of flash
- #address-cells: Number of cells required to define a chip select
		address on the SPI bus. Should be set to 1.
- #size-cells: specifies the number of cells used to represent the size
		of an address.
- compatible: should be "m25p80", "jedec,spi-nor"
- reg: Chip select address of device.
- spi-max-frequency: Maximum SPI clocking speed of device in Hz.
- disable-4byte-address: Disable 4byte address mode.
- m25p,fast-read: Set whether m25p supports fast-read.
- spi-cpol: Empty property indicating device requires inverse clock
	    polarity (CPOL) mode.
- spi-cpha: Empty property indicating device requires shifted clock
            phase (CPHA) mode.

In sub node of partition@0
- label: Name of patition.
- reg : start address and length to partition.

Example:
in dtsi file
	spi0: spi@30000000 {
		compatible = "nexell,nxp3220-dw-spi";
		reg = <0x30000000 0x1000>;
		interrupts = <GIC_SPI 93 4>;
		clocks = <&cmu CLK_SPI0_CORE>
			<&cmu CLK_SPI0_APB>;
		clock-names = "core", "apb";
		num-cs = <1>;
		spi-mode = <0>;
		pinctrl-names = "default";
		pinctrl-0 = <&spi0_bus>;
		status = "disabled";

		flash: m25p80 {
			#address-cells = <1>;
			#size-cells = <1>;
			compatible = "m25p80", "jedec,spi-nor";
			reg = <0>;
			spi-max-frequency = <1000000>;
			disable-4byte-address;
			m25p,fast-read;
			spi-cpol;
			spi-cpha;

			partition@0 {
				label = "part0";
				reg = <0x500000 0x7b00000>;
			};
		};
	};
```

## Documentation/devicetree/bindings/thermal/nexell-thermal.txt
```
* Nexell Thermal Management Unit (TMU)

Nexell Nxp3220 TMU is used same Samsung TMU.

** Required properties:

- compatible :Must be  "nexell,nxp3220-tmu"

- interrupt-parent : The phandle for the interrupt controller
- reg : Address range of the thermal registers. For soc's which has multiple
	instances of TMU and some registers are shared across all TMU's like
	interrupt related then 2 set of register has to supplied. First set
	belongs	to register set of TMU instance and second set belongs to
	registers shared with the TMU instance.

- interrupts : Should contain interrupt for thermal system
- clocks : The main clocks for TMU device
	-- only use pclk clcok.
- clock-names : Thermal system clock name
	-- "tmu_apbif" operational clock for current TMU channel
- vtmu-supply: This entry is optional and provides the regulator node supplying
		voltage to TMU. If needed this entry can be placed inside
		board/platform specific dts file.
Following properties are mandatory (depending on SoC):
- samsung,tmu_gain: Gain value for internal TMU operation.
- samsung,tmu_reference_voltage: Value of TMU IP block's reference voltage
- samsung,tmu_noise_cancel_mode: Mode for noise cancellation
- samsung,tmu_efuse_value: Default level of temperature - it is needed when
			   in factory fusing produced wrong value
- samsung,tmu_min_efuse_value: Minimum temperature fused value
- samsung,tmu_max_efuse_value: Maximum temperature fused value
- samsung,tmu_first_point_trim: First point trimming value
- samsung,tmu_second_point_trim: Second point trimming value
- samsung,tmu_default_temp_offset: Default temperature offset
- samsung,tmu_cal_type: Calibration type

Example:

	tmuctrl_0: tmuctrl@200e0000 {
		compatible = "nexell,nxp3220-tmu";
		reg = <0x200e0000 0x1000>;
		interrupts = <GIC_SPI 110 IRQ_TYPE_NONE>;
		clocks = <&cmu  CLK_TMU0_APB>;
		clock-names = "tmu_apbif";
		#include "nxp3220-tmu-sensor-conf.dtsi"
	};
```

## Documentation/devicetree/bindings/timer/nexell,nxp3220-timer.txt
```
Nexell NXP3220 Timer Controller

Required properties:
- compatible : should be "nexell,nxp3220-timer"
- reg : Specifies base physical address and size of the registers.
- interrupts : The interrupt of the first timer
- clocks: phandle to the source clock
- clock-names : clock names
- clksource : timer channel to use source clock.
- clkevent'N' : timer channel to use event clock.
- clksrc-frequency : clock-source timer frequency
- clkevt-frequencies : clock-event timer frequencies

Example:
	pwm-timer@208c0000 {
		compatible = "nexell,nxp3220-timer";
		reg = <0x208c0000 0x1000>;
		clocks =  <&cmu CLK_TIMER0_APB>,
			  <&cmu CLK_TIMER0_TCLK0>,
			  <&cmu CLK_TIMER0_TCLK1>,
			  <&cmu CLK_TIMER0_TCLK2>;
		clock-names = "apb", "clksrc", "clkevt0", "clkevt1";
		clksrc-frequency = <100000000>;
		clkevt-frequencies = <100000000>, <100000000>;
		interrupts = <GIC_SPI 107 IRQ_TYPE_NONE>,
			     <GIC_SPI 108 IRQ_TYPE_NONE>;
		clksource = <0>;
		clkevent0 = <1>;
		clkevent1 = <2>;
	};

	cmu {
		...
		assigned-clocks = ...
			  <&cmu CLK_SRC_TIMER0_APB>,
			  <&cmu CLK_SRC_TIMER0_TCLK0>,
			  <&cmu CLK_SRC_TIMER0_TCLK1>,
			  <&cmu CLK_SRC_TIMER0_TCLK2>,
		...
		assigned-clock-parents = ...
			 <&pll_0 0>,	/* SRC_TIMER0_APB */
			 <&pll_0 0>,	/* SRC_TIMER0_TCLK0 */
			 <&pll_0 0>,	/* SRC_TIMER0_TCLK1 */
			 <&pll_0 0>,	/* SRC_TIMER0_TCLK2 */
		...
		assigned-clock-rates = ...
		       <100000000>,     /* SRC_TIMER0_APB */
		       <0>,             /* SRC_TIMER0_TCLK0 */
		       <0>,             /* SRC_TIMER0_TCLK1 */
		       <0>,             /* SRC_TIMER0_TCLK2 */
		...
	};
```
